## boards/shields/1key/Kconfig.defconfig
```kconfig
if 1KEY

config ZMK_KEYBOARD_NAME
    default "Test"

config BUILD_OUTPUT_UF2
    default y

config BT_CTLR
	default BT

config ZMK_BLE
	default y

config ZMK_USB
	default y


endif 
```
